#include "hal_data.h"
#include <stdio.h>

FSP_CPP_HEADER
void R_BSP_WarmStart(bsp_warm_start_event_t event);
FSP_CPP_FOOTER
/* Callback function */

void delay(int ms){
    R_BSP_SoftwareDelay(ms, BSP_DELAY_UNITS_MILLISECONDS);
}
/* Callback function */
void spi_callback(spi_callback_args_t *p_args)
{
    /* TODO: add your own code here */
}

/*******************************************************************************************************************//**
 * main() is generated by the RA Configuration editor and is used to generate threads if an RTOS is used.  This function
 * is called by main() when no RTOS is used.
 **********************************************************************************************************************/
void hal_entry(void)
{
    init(0x6f);
    //PWM(0x6f);
    setPWMFreq(60);
    Mid();
    delay(10);

    int speed = 50;
    setSpeed(speed);

    uint8_t data = 0x0F;
    uint8_t readData = 0x00;
    //uint8_t readDatas[5] = {0,};
    int Kp = 1;
    int Kp_term = 0;
    int Ki_term = 0;
    int Ki = 1;
    //int Kd = 1;
    const int SAFE_DIST = 15;
    int err = 0;
    const int SPEEDGAIN = 50;
    int speedinput = speed;
    while(1){
        R_SPI_WriteRead(&g_spi1_ctrl, &data, &readData, 1, SPI_BIT_WIDTH_8_BITS);
        //R_SPI_WriteRead(&g_spi1_ctrl, &data, readDatas, 5, SPI_BIT_WIDTH_8_BITS);
        int nowdist = (int)readData;

        //
        if( readData == 'w'){
            Forward();
        }
        else if( readData == 'x'){
            Backward();
        }
        else if( readData == 'f'){
            Release();
        }
        else if( readData == 's'){
            Mid();
        }
        else if( readData == 'a'){
            Left();
        }
        else if( readData == 'd'){
            Right();
        }else{
            err = SAFE_DIST - nowdist;
            //Kp_term = Kp * err;

            speedinput = -err + SPEEDGAIN;

            if(err > 0){
                Release();
            }else{
                setSpeed(speedinput);
            }


        }
        delay(10);
    }
}


/*******************************************************************************************************************//**
 * This function is called at various points during the startup process.  This implementation uses the event that is
 * called right before main() to set up the pins.
 *
 * @param[in]  event    Where at in the start up process the code is currently at
 **********************************************************************************************************************/
void R_BSP_WarmStart(bsp_warm_start_event_t event)
{
    if (BSP_WARM_START_RESET == event)
    {

    }

    if (BSP_WARM_START_POST_C == event)
    {
        /* C runtime environment and system clocks are setup. */

        /* Configure pins. */
        R_IOPORT_Open (&g_ioport_ctrl, g_ioport.p_cfg);
        R_IIC_MASTER_Open(&g_i2c_master0_ctrl, &g_i2c_master0_cfg);
        R_SPI_Open(&g_spi1_ctrl, &g_spi1_cfg);
    }
}
